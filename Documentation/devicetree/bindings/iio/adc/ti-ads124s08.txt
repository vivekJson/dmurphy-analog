## Documentation/devicetree/bindings/iio/adc/ti-ads124s08.txt
```
* Texas Instruments' ads124s08 and ads124s06 ADC chip

Required properties:
 - compatible: Should be "ti,ads124s08" or "ti,ads124s06"
 - reg: spi chip select number for the device

Recommended properties:
 - spi-max-frequency: Definition as per
		Documentation/devicetree/bindings/spi/spi-bus.txt
 - spi-cpha: Definition as per
		Documentation/devicetree/bindings/spi/spi-bus.txt

Optional properties:
 - vref-supply: The regulator supply for ADC reference voltage
 - reset-gpios: GPIO pin used to reset the device.

Example:
adc@0 {
	compatible = "ti,ads8688";
	reg = <0>;
	vref-supply = <&vdd_supply>;
	spi-max-frequency = <1000000>;
	spi-cpha;
	reset-gpios = <&gpio1 16 GPIO_ACTIVE_LOW>;
};
```

## Documentation/devicetree/bindings/iio/heart_monitor/ti_afe4403.txt
```
* Texas Instruments - AFE4403 Heart rate and Pulse Oximeter

The device consists of a low-noise receiver channel
with an integrated analog-to-digital converter (ADC),
an LED transmit section, and diagnostics for sensor and LED fault detection.

Required properties:
  - compatible: Must contain "ti,afe4403".
  - ste-gpio: GPIO for the spi control line
  - data-ready-gpio: GPIO interrupt when the afe4403 has data
  - led-supply: Chip supply to the device

Optional properties:
  - reset-gpio: GPIO used to reset the device via HW

Example:

&heart_rate {
	compatible = "ti,afe4403";
	ste-gpio = <&gpio1 29 GPIO_ACTIVE_HIGH>;
	data-ready-gpio = <&gpio1 28 GPIO_ACTIVE_HIGH>;
	led-supply = <&vbat>;
};

Technical Datasheet:
http://www.ti.com/product/AFE4403/datasheet
```

## Documentation/devicetree/bindings/iio/heart_monitor/ti_afe4404.txt
```
* Texas Instruments - AFE4404 Heart rate and Pulse Oximeter

The device consists of a low-noise receiver channel
with an integrated analog-to-digital converter (ADC),
an LED transmit section, and diagnostics for sensor and LED fault detection.

Required properties:
  - compatible: Must contain "ti,afe4404".
  - reg - I2C address of the device
  - data-ready-gpio: GPIO interrupt when the afe4404 has data
  - led-supply: Chip supply to the device

Optional properties:
  - reset-gpio: GPIO used to reset the device via HW

Example:

&heart_rate {
	compatible = "ti,afe4404";
	reg = <0x58>;
	data-ready-gpio = <&gpio1 28 GPIO_ACTIVE_HIGH>;
	led-supply = <&vbat>;
};
```

## Documentation/devicetree/bindings/input/ti,drv260x.txt
```
Texas Instruments - drv260x Haptics driver family

The drv260x family serial control bus communicates through I2C protocols

Required properties:
	- compatible - One of:
		"ti,drv2604" - DRV2604
		"ti,drv2605" - DRV2605
		"ti,drv2605l" - DRV2605L
	- reg -  I2C slave address
	- supply- Required supply regulators are:
		"vbat" - battery voltage
	- mode - Power up mode of the chip (defined in include/dt-bindings/input/ti-drv260x.h)
		DRV260X_LRA_MODE - Linear Resonance Actuator mode (Piezoelectric)
		DRV260X_LRA_NO_CAL_MODE - This is a LRA Mode but there is no calibration
				sequence during init.  And the device is configured for real
				time playback mode (RTP mode).
		DRV260X_ERM_MODE - Eccentric Rotating Mass mode (Rotary vibrator)
	- library-sel - These are ROM based waveforms pre-programmed into the IC.
				This should be set to set the library to use at power up.
				(defined in include/dt-bindings/input/ti-drv260x.h)
		DRV260X_LIB_A - Pre-programmed Library
		DRV260X_LIB_B - Pre-programmed Library
		DRV260X_LIB_C - Pre-programmed Library
		DRV260X_LIB_D - Pre-programmed Library
		DRV260X_LIB_E - Pre-programmed Library
		DRV260X_LIB_F - Pre-programmed Library

Optional properties:
	- enable-gpio - gpio pin to enable/disable the device.
	- vib_rated_voltage - The rated voltage of the actuator in millivolts.
			  If this is not set then the value will be defaulted to
			  3.2 v.
	- vib_overdrive_voltage - The overdrive voltage of the actuator in millivolts.
			  If this is not set then the value will be defaulted to
			  3.2 v.
Example:

drv2605l: drv2605l@5a {
		compatible = "ti,drv2605l";
		reg = <0x5a>;
		enable-gpio = <&gpio1 28 GPIO_ACTIVE_HIGH>;
		mode = <DRV260X_LRA_MODE>;
		library-sel = <DRV260X_LIB_SEL_DEFAULT>;
		vib-rated-voltage = <3200>;
		vib-overdriver-voltage = <3200>;
};

For more product information please see the link below:
http://www.ti.com/product/drv2605
```

## Documentation/devicetree/bindings/leds/leds-lp5024.txt
```
* Texas Instruments - LP5024/18 RGB LED driver

The LP5024/18 is 24-Channel, I2C RGB LED Drivers that can group RGB LEDs into
a LED group or control them individually.

The main difference between the LP5024 and L5018 is the number of
RGB LEDs they support.  The LP5024 supports twenty four strings while the
LP5018 supports eighteen strings.

Required properties:
	- compatible:
		"ti,lp5018"
		"ti,lp5024"
	- reg :  I2C slave address
	- #address-cells : 1
	- #size-cells : 0

Optional properties:
	- enable-gpios : gpio pin to enable/disable the device.
	- vled-supply : LED supply

Required child properties:
	- reg : Is the child node iteration.
	- led-sources : LP5024 - 0 - 7
			LP5018 - 0 - 5
			Declares the LED string or strings that the child node
			will control.  If ti,control-bank is set then this
			property will contain multiple LED IDs.

Optional child properties:
	- label : see Documentation/devicetree/bindings/leds/common.txt
	- linux,default-trigger :
	   see Documentation/devicetree/bindings/leds/common.txt
	- ti,control-bank : Indicates that the LED strings declared in the
			    led-sources property are grouped within a control
			    bank for brightness and mixing control.

Example:

led-controller@28 {
	compatible = "ti,lp5024";
	reg = <0x28>;
	#address-cells = <1>;
	#size-cells = <0>;

	enable-gpios = <&gpio1 28 GPIO_ACTIVE_HIGH>;
	vled-supply = <&vbatt>;

	led@0 {
		reg = <0>;
		led-sources = <1>;
	};

	led@1 {
		reg = <1>;
		led-sources = <0 6>;
		ti,control-bank;
	};

}

For more product information please see the link below:
http://www.ti.com/lit/ds/symlink/lp5024.pdf
```

## Documentation/devicetree/bindings/leds/leds-lp50xx.txt
```
* Texas Instruments - LP5018/24/30/36 RGB LED driver

The LP50XX is multi-channel, I2C RGB LED Drivers that can group RGB LEDs into
a LED group or control them individually.

The difference in these RGB LED drivers is the number of supported RGB strings.

Required properties:
	- compatible:
		"ti,lp5018"
		"ti,lp5024"
		"ti,lp5030"
		"ti,lp5036"
	- reg :  I2C slave address
		lp5018/24 - 0x28
		lp5030/36 - 0x30
	- #address-cells : 1
	- #size-cells : 0

Optional properties:
	- enable-gpios : gpio pin to enable/disable the device.
	- vled-supply : LED supply

Required child properties:
	- reg : Is the child node iteration.

Required Child properties but only one should be defined per child:
Either one of these two properties are required for each node.  The 
property ti,led-bank takes precedence over the ti,led-module within the same
node.

	- ti,led-module : This property denotes the single LED module number
			  that will be controlled in the LED class instance.
	- ti,led-bank : This property denotes the LED module numbers that will
			be controlled as a single RGB cluster.  Each LED module
			number will be controlled by a single LED class instance.
			There can only be one instance of the ti,led-bank
			property for each device node.

The LED outpus associated with the LED modules are defined in Table 1 of the
corresponding data sheets.

LP5018 - 6 Total RGB cluster LED outputs 0-5
LP5024 - 8 Total RGB cluster LED outputs 0-7
LP5030 - 10 Total RGB cluster LED outputs 0-9
LP5036 - 12 Total RGB cluster LED outputs 0-11

Optional child properties:
	- label : see Documentation/devicetree/bindings/leds/common.txt
	- linux,default-trigger :
	   see Documentation/devicetree/bindings/leds/common.txt

Examples:
LP5018 and LP5024 example:
led-controller@29 {
	#address-cells = <1>;
	#size-cells = <0>;
	compatible = "ti,lp5024";
	reg = <0x29>;
	enable-gpios = <&gpio1 28 GPIO_ACTIVE_HIGH>;
	vled-supply = <&vmmcsd_fixed>;

	led@0 {
	        reg = <0>;
	        label = "led1_mod";
		ti,led-module = <1>;
	};

	led@1 {
	        reg = <1>;
	        label = "banked_leds";
		ti,led-bank = <0 2 5 3 >;
	};

	led@2 {
	        reg = <2>;
	        label = "led4_mod";
		ti,led-module = <4>;
	};

	led@3 {
	        reg = <3>;
	        label = "led7_mod";
		ti,led-module = <7>;
	};

	led@4 {
	        reg = <4>;
	        label = "led6_mod";
		ti,led-module = <6>;
	};
};

LP5030 and LP5036 example:
led-controller@30 {
	#address-cells = <1>;
	#size-cells = <0>;
	compatible = "ti,lp5036";
	reg = <0x30>;
	enable-gpios = <&gpio1 28 GPIO_ACTIVE_HIGH>;
	vled-supply = <&vmmcsd_fixed>;

	led@0 {
	        reg = <0>;
	        label = "led1_mod";
		ti,led-module = <1>;
	};

	led@1 {
	        reg = <1>;
	        label = "led_banked";
		ti,led-bank = <0 2 5 3 9 10 >;
	};

	led@2 {
	        reg = <2>;
	        label = "led4_mod";
		ti,led-module = <4>;
	};

	led@3 {
	        reg = <3>;
	        label = "led7_mod";
		ti,led-module = <7>;
	};

	led@4 {
	        reg = <4>;
	        label = "led6_mod";
		ti,led-module = <6>;
	};

	led@5 {
	        reg = <5>;
	        label = "led8_mod";
		ti,led-module = <8>;
	};
};


For more product information please see the link below:
http://www.ti.com/lit/ds/symlink/lp5024.pdf
http://www.ti.com/lit/ds/symlink/lp5036.pdf
```

## Documentation/devicetree/bindings/net/can/tcan4x5x.txt
```
Texas Instruments TCAN4x5x CAN Controller
================================================

This file provides device node information for the TCAN4x5x interface contains.

Required properties:
	- compatible: "ti,tcan4x5x"
	- reg: 0
	- #address-cells : 1
	- #size-cells : 0
	- spi-max-frequency: Maximum frequency of the SPI bus the chip can
			     operate at should be less than or equal to 18 MHz.
	- data-ready-gpios: Interrupt GPIO for data and error reporting. 
	- wake-up-gpios: Wake up GPIO to wake up the TCAN device

Optional properties:
	- clocks: Processor clock phandles (see clock bindings for details)
		  If no clock is defined then the default 40MHz freq is set.
	- reset-gpios: Hardwired output GPIO. If not defined then software
		       reset.

Example:
tcan4x5x: tcan4x5x@0 {
		compatible = "ti,tcan4x5x";
		reg = <0>;
		#address-cells = <1>;
		#size-cells = <1>;
		clocks = <&tclkin_ck>;
		spi-max-frequency = <10000000>;
		data-ready-gpios = <&gpio1 16 GPIO_ACTIVE_LOW>;
		wake-up-gpios = <&gpio1 17 GPIO_ACTIVE_LOW>;
		reset-gpios = <&gpio1 27 GPIO_ACTIVE_LOW>;
	};
```

## Documentation/devicetree/bindings/power/supply/bq25150.txt
```
Binding for TI bq25150 500-mA Linear charger

The BQ25150 is a highly integrated battery charge management IC that integrates
the most common functions for wearable devices, namely a charger, an
output voltage rail, ADC for battery and system monitoring, and
push-button controller.

Required Properties:
	- compatible = Should contain "ti,bq25150"
	- reg: int I2c address 0x6b
	- #address-cells: 1;
	- #size-cells: = 0;

Optional Properties:
	- ti,battery-regulation-voltage: integer, maximum charging voltage in uV.
	- ti,charge-current: integer, maximum charging current in uA.
	- reset-gpios: GPIO used for Master reset
	- low-power-gpios: GPIO used for low power mode of IC.
	- pg-gpios: GPIO used for connecting the bq2425x device PG (Power Good) pin.
	    This pin is not available on all devices however it should be used if
	    possible as this is the recommended way to obtain the charger's input PG
	    state. If this pin is not specified a software-based approach for PG
	    detection is used.

Example
bq25150@6b {
	compatible = "ti,bq25150";
	reg = <0x6b>;
	#address-cells = <1>;
	#size-cells = <0>;

	ti,charge-current = <0x0>;
	ti,battery-regulation-voltage = <0x0>;
};

Reference Datasheet:
http://www.ti.com/lit/ds/symlink/bq25150.pdf
```

## configs/am335x_evm_uart3_defconfig
```kconfig
CONFIG_SPL=y
CONFIG_SYS_EXTRA_OPTIONS="SERIAL4,CONS_INDEX=4,ENV_IS_IN_MMC"
+S:CONFIG_ARM=y
+S:CONFIG_TARGET_AM335X_EVM=y
```

## drivers/iio/heart_monitor/Kconfig
```kconfig
#
# Heart Rate Monitor drivers
#
# When adding new entries keep the list in alphabetical order

menu "Heart Rate Monitors"

config AFE4403
	tristate "TI AFE4403 Heart Rate Monitor"
	depends on SPI_MASTER
	select IIO_BUFFER
	help
	  Say yes to choose the Texas Instruments AFE4403
	  heart rate monitor and low-cost pulse oximeter.

	  To compile this driver as a module, choose M here: the
	  module will be called afe4403 heart rate monitor and
	  low-cost pulse oximeter.
endmenu
```

## drivers/net/can/m_can/Kconfig
```kconfig
config CAN_M_CAN
	tristate "Bosch M_CAN support"
	---help---
	  Say Y here if you want to support for Bosch M_CAN controller.

config CAN_M_CAN_CORE
	depends on CAN_M_CAN
	tristate "Bosch M_CAN Core support"
	---help---
	  Say Y here if you want to support for Bosch M_CAN controller.

config CAN_M_CAN_PLATFORM
	depends on HAS_IOMEM
	depends on CAN_M_CAN_CORE
	tristate "Bosch M_CAN devices"
	---help---
	  Say Y here if you want to support for Bosch M_CAN controller.
```

## drivers/usb/typec/Kconfig
```kconfig
config TYPEC
	bool "support Type C feature"
	default n
	---help---
	  Say Y here to support Type C feature

source "drivers/usb/typec/tusb320/Kconfig"
source "drivers/usb/typec/tps6598x/Kconfig"
```

## drivers/usb/typec/tps6598x/Kconfig
```kconfig
# TI USB Type C and PD controller

config TPS6598X_TYPEC
	tristate "TPS6598X USB Type C and PD controller"
	depends on TYPEC && GPIOLIB && I2C
	default n
	help
	  Say Y here to enable tps6598x Type C Connector support.
```
